## drivers/can/Kconfig.can2040
```kconfig
# can2040 configuration options

# Copyright (c) 2025 Dmitrii Sharshakov <d3dx12.xx@gmail.com>
# SPDX-License-Identifier: GPL-3.0-only OR Apache-2.0

config CAN_CAN2040
	bool "can2040 PIO-based driver (out-of-tree)"
	default y
	depends on DT_HAS_CAN2040_CAN2040_ENABLED
	help
	  This enables support for can2040 CAN driver, based on RP2 PIO, using an external library.

if CAN_CAN2040

config CAN_MAX_FILTER
	int "Maximum number of concurrent active filters"
	default 16
	range 1 1024
	help
	  Defines the array size of the filters.
	  Must be at least the size of concurrent reads.

endif # CAN_CAN2040
```

## dts/bindings/can/can2040,can2040.yaml
```yaml
# Copyright (c) 2025 Dmitrii Sharshakov <d3dx12.xx@gmail.com>
# SPDX-License-Identifier: GPL-3.0-only OR Apache-2.0

description: |
  PIO-based CAN controller for RP2 series, using the can2040 driver

  Example:
    &pinctrl {
      can2040_default: can2040_default {
        rx_pins {
          pinmux = <PIO0_P4>;
          input-enable;
          bias-pull-up;
        };
        tx_pins {
          pinmux = <PIO0_P5>;
        };
      };
    };

    &pio0 {
      status = "okay";

      can2040: can2040 {
        compatible = "can2040,can2040";
        status = "okay";
        clocks = <&clk_sys>;
        clock-names = "sys";
        pinctrl-0 = <&can2040_default>;
        pinctrl-names = "default";
        bitrate = <1000000>;
      };
    };

compatible: "can2040,can2040"

include: [can-controller.yaml, pinctrl-device.yaml]

properties:
  clocks:
    required: true

  clock-names:
    required: true

  pinctrl-0:
    required: true

  pinctrl-names:
    required: true

  bitrate:
    required: true
```
